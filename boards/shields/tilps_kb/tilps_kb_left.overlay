/*
 * Tilps KB — LEFT half overlay
 *
 * MCU  : XIAO nRF52840
 * Role : Central (BLE host connection + split central)
 *
 * Column GPIOs (outermost → innermost, col 0 → 4):
 *   Col0 = P0.03 (D1)   Col1 = P0.28 (D2)   Col2 = P0.29 (D3)
 *   Col3 = P0.04 (D4)   Col4 = P0.05 (D5)
 *
 * Row GPIOs (top → bottom, row 0 → 4):
 *   Row0 = P1.15 (D10)  Row1 = P1.14 (D9)   Row2 = P1.13 (D8)
 *   Row3 = P1.12 (D7)   Row4 = P1.11 (D6)   ← thumb row (SW21 only, col 4)
 *
 * Diode direction: column-to-row (col2row)
 */

#include "tilps_kb.dtsi"

/* Extend the kscan0 node (defined in tilps_kb.dtsi) with left-side column GPIOs.
 * Columns listed outermost → innermost (col 0 = left edge, col 4 = center/thumb). */
&kscan0 {
    col-gpios
        = <&gpio0  3 GPIO_ACTIVE_HIGH>   /* Col0 – P0.03 (outermost) */
        , <&gpio0 28 GPIO_ACTIVE_HIGH>   /* Col1 – P0.28 */
        , <&gpio0 29 GPIO_ACTIVE_HIGH>   /* Col2 – P0.29 */
        , <&gpio0  4 GPIO_ACTIVE_HIGH>   /* Col3 – P0.04 */
        , <&gpio0  5 GPIO_ACTIVE_HIGH>   /* Col4 – P0.05 (innermost / thumb) */
        ;
};
