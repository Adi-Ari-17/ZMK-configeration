## boards/shields/tilps_kb/Kconfig.defconfig
```kconfig
if SHIELD_TILPS_KB_LEFT || SHIELD_TILPS_KB_RIGHT

config ZMK_KEYBOARD_NAME
    default "Tilps KB"

config ZMK_SPLIT
    default y

if SHIELD_TILPS_KB_LEFT

config ZMK_SPLIT_ROLE_CENTRAL
    default y

endif # SHIELD_TILPS_KB_LEFT

endif # SHIELD_TILPS_KB_LEFT || SHIELD_TILPS_KB_RIGHT
```

## boards/shields/tilps_kb/Kconfig.shield
```kconfig
config SHIELD_TILPS_KB_LEFT
    def_bool $(shields_list_contains,tilps_kb_left)

config SHIELD_TILPS_KB_RIGHT
    def_bool $(shields_list_contains,tilps_kb_right)
```
